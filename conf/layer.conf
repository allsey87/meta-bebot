## conf/layer.conf
```bitbake
# We have a conf directory, append to BBPATH
BBPATH .= ":${LAYERDIR}"

# We have a recipes directory, add to BBFILES
BBFILES += "${LAYERDIR}/recipes-*/*/*.bb \
            ${LAYERDIR}/recipes-*/*/*.bbappend"

BBFILE_COLLECTIONS += "meta-bebot"
BBFILE_PATTERN_meta-bebot := "^${LAYERDIR}/"
BBFILE_PRIORITY_meta-bebot = "7"
```

## conf/machine/bebot.conf
```bitbake
#@TYPE: Machine
#@NAME: BeBot
#@DESCRIPTION: Machine configuration for the DuoVero-based BeBot

SOC_FAMILY = "omap4"
TARGET_ARCH = "arm"

# Default to ARM hardfloat ABI, for soft-float set DEFAULTTUNE to
# "armv7a-neon" in local.conf or comment this next line
DEFAULTTUNE ?= "cortexa9hf-neon"

require conf/machine/include/soc-family.inc
require conf/machine/include/tune-cortexa9.inc

# Specify kernel recipe
PREFERRED_PROVIDER_virtual/kernel ?= "linux-bebot"

# Specify u-boot parameters
PREFERRED_PROVIDER_virtual/bootloader = "u-boot"
PREFERRED_PROVIDER_u-boot = "u-boot"

UBOOT_ENTRYPOINT = "0x80008000"
UBOOT_LOADADDRESS = "0x80008000"
UBOOT_MACHINE = "bebot_config"
SPL_BINARY = "MLO"
UBOOT_SUFFIX = "img"

EXTRA_IMAGEDEPENDS += "u-boot"

# Specify files for the boot partition for wic
# Note: if UBOOT_ENV is set, it should also be included here
IMAGE_BOOT_FILES ?= "u-boot.${UBOOT_SUFFIX} ${SPL_BINARY}"

SERIAL_CONSOLES = "115200;ttyO2"

# Include additional drivers
# kernel-module-ov5640
# MACHINE_EXTRA_RDEPENDS += " kernel-module-bebot-chassis-rfs"

# Image for SD Card
IMAGE_FSTYPES ?= "tar.bz2"

# Include wifi firmware
MACHINE_EXTRA_RDEPENDS += "linux-firmware-sd8787"

# Ship all kernel modules by default
MACHINE_EXTRA_RRECOMMENDS = " kernel-modules"
MACHINE_FEATURES = "bluetooth ext2 serial usbgadget usbhost vfat wifi"
```
